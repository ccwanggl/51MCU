// 共阴极
unsigned int common_anode_led[] = { 0x3f,   // 0
                                    0x06,   // 1
                                    0x5b,   // 2 
                                    0x4f,   // 3 
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                                    0x71,   // f
                                    0x00    // 
                                    };
// 共阳级
unsigned int common_cathode_led[] = {   0xc0,   // 0
                                        0xf9,   // 1
                                        0xa4,   // 2
                                        0xb0,   // 3 
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                                        0x8e,   // f
                                        0xff
                                        };
